// SPDX-License-Identifier: BSD-3-Clause
/*
 * Copyright (c) 2023-2026 Qualcomm Innovation Center, Inc. All rights reserved.
 * Xiaomi Annibale Audio Overlay
 */

/dts-v1/;
/plugin/;

#include "annibale-audio-mtp.dtsi"

/ {
    model = "Qualcomm Technologies, Inc. Annibale based on SM8750";
    compatible = "qcom,sun-mtp", "qcom,sun", "qcom,sunp-mtp", "qcom,sunp", "qcom,mtp";
    qcom,msm-id = <0x100026a 0x20000 0x27f 0x10000 0x26a 0x10000 0x27f 0x20000 0x26a 0x20000 0x100027f 0x10000 0x100026a 0x10000 0x100027f 0x20000>;
    qcom,board-id = <0x40008 0x00>;
    xiaomi,miboard-id = <0x0b 0x00>;
};
